; --------------------------------------------------------------------------------
; @Title: A13-OlinuXino Linux debugging Allwinner A13
; @Description:
;   The example is generated for A13-OlinuXino* boards using an ICD.
;   It will NOT run on any other board, but may be used as a template
;   for others.
; @Keywords: uboot, Allwinner, a13*, A13*
; @Author: Giulio Benetti <giulio.benetti@benettiengineering.com>
; @Board: A13-Olinuxino*
; @Chip: A13*
; @Copyright: (C) 1981-2021 Benetti Engineering sas, licensed for use with TRACE32(R) only
; --------------------------------------------------------------------------------

LOCAL &uboot_path
LOCAL &linux_path
LOCAL &dtb_path
LOCAL &ka_path
LOCAL &awareness

&bsp_path="/home/giuliobenetti/git/cedrus/output-a13-olinuxino-nfsroot-linux-5.14-gstreamer-1.19.3"
&uboot_path="&bsp_path/build/uboot-2021.10"
&linux_path="&bsp_path/build/linux-5.14.21"
&dtb_path="&bsp_path/images"

; Debugger Reset
;WinPAGE.RESet
;AREA.RESet
;WinPOS 0. 25. 75. 9. 0. 0. W000
;AREA.view

PRINT "resetting..."

RESet
SYStem.CPU CortexA8

SYSTEM.RESETOUT ; hard reset
SYStem.JTAGCLOCK 20MHz

SYStem.CONFIG MEMORYACCESSPORT 0.
SYStem.CONFIG DEBUGACCESSPORT 1.
SYStem.CONFIG COREDEBUG.Base 0xAC328000

SYStem.Option DACR ON          ; give Debugger global write permissions
TrOnchip.Set DABORT OFF        ; used by Linux for page miss!
TrOnchip.Set PABORT OFF        ; used by Linux for page miss!
TrOnchip.Set UNDEF OFF         ; my be used by Linux for FPU detection
SYStem.Option MMUSPACES OFF    ; enable space ids to virtual addresses
SYStem.Option EnReset OFF
SYStem.Option TRST ON

; Allwinner A13 BROM
MAP.BONCHIP 0xffff0000--0xffff7fff

Break.Implementation Program Onchip

SETUP.IMASKASM ON          ; lock interrupts while single stepping
SETUP.IMASKHLL ON          ; lock interrupts while single stepping in HLL

SYStem.Up

; Load spl in sram
data.load.auto &uboot_path/spl/u-boot-spl

; Start and wait for spl to be executed and fail on sd-card boot
; (because there's no sd-card inserted)
Go
Wait 1s
Break

; Load real uboot
Data.LOAD.Binary &uboot_path/u-boot.bin 0x4a000000 /NoClear
Register.Init
r.s pc 0x4a000000

PRINT "loading Linux image..."
; Loading Linux image and DTB via ICD
Data.LOAD.Binary &linux_path/arch/arm/boot/zImage 0x42000000
; Load the Linux kernel symbols into the debugger
PRINT "loading Linux kernel symbols..."
Data.LOAD.Elf &linux_path/vmlinux /gnu /NoCODE
; Load DTB
PRINT "loading DTB..."
Data.LOAD.Binary &dtb_path/sun5i-a13-olinuxino.dtb 0x43000000 /NoClear

; Open serial terminal window on ttyUSB0
DO ~~/demo/etc/terminal/serial/term.cmm /dev/ttyUSB0 115200.

TERM.Mode RAW

TERM.SIZE 500. 25.

; Starting u-boot
Go
PRINT "Starting Linux..."
; Wait for uboot to be ready to receive characters on serial
wait 3s
; Stop autoboot of U-Boot
TERM.Out 0x0a
WAIT 0.1s
; Set boot arguments few characters per time because of A13 uart RX driver bug
TERM.Out "setenv bootargs console=ttyS0,115200 ip=192.168.111.100::"
WAIT 0.1s
TERM.Out ":255.255.255.0::usb0:off root=/dev/nfs rw nfsroot=192.168.111.1:"
WAIT 0.1s
TERM.Out "/home/giuliobenetti/git/cedrus"
WAIT 0.1s
TERM.Out "/output-a13-olinuxino-nfsroot-linux-5.14-gstreamer-1.19.3/"
WAIT 0.2s
TERM.Out "images/nfs,tcp,v3 rootwait panic=10" 0x0a
WAIT 0.1s

TERM.Out "bootz 0x42000000 - 0x43000000" 0x0a
WAIT 0.1s
break

Go.direct start_kernel /Onchip
WAIT !run()

SYStem.Option MMUSPACES ON    ; enable space ids to virtual addresses

; Map the virtual kernel symbols to physical addresses
; to give the debugger access to it before CPU MMU is
; initialized
PRINT "initializing debugger MMU..."
MMU.FORMAT LINUX swapper_pg_dir 0xc0000000--0xdfffffff 0x40000000
TRANSlation.COMMON 0bf000000--0ffffffff     ; common area for kernel and processes
TRANSlation.TableWalk ON   ; debugger uses a table walk to decode virtual addresses
TRANSlation.ON

; Initialize Linux Awareness
PRINT "initializing RTOS support..."
TASK.CONFIG ~~/demo/arm/kernel/linux/awareness/linux.t32
MENU.ReProgram ~~/demo/arm/kernel/linux/awareness/linux.men

; Group kernel area to be displayed with red bar
GROUP.Create "kernel" 0xc0000000--0xffffffff /RED

Go.direct cpu_startup_entry /Onchip
WAIT !run()

Go

Mode.Hll
List

break.config.method.program Onchip

TASK.SYMbol.Option ROOTPATH "&bsp_path/images/nfs"
TASK.sYmbol.Option AutoLoad CURRLIB
Symbol.autoload.CHECK ON

enddo
