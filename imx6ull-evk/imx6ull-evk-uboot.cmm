; --------------------------------------------------------------------------------
; @Title: IMX6ULL-EVK U-Boot debugging NXP i.MX6ULL
; @Description:
;   The example is generated for * boards using an ICD.
;   It will NOT run on any other board, but may be used as a template
;   for others.
; @Keywords: uboot, Nxp, imx6ull*, IMX6ULL*
; @Author: Giulio Benetti <giulio.benetti@benettiengineering.com>
; @Board: IMX6ULL-EVK*
; @Chip: IMX6ULL*
; @Copyright: (C) 1981-2022 Benetti Engineering sas, licensed for use with TRACE32(R) only
; --------------------------------------------------------------------------------

LOCAL &uboot_path
LOCAL &ka_path
LOCAL &awareness

&uboot_path="/home/giuliobenetti/git/tekvox/output-tekvox/build/uboot-2022.10"

; Debugger Reset
WinPAGE.RESet
AREA.RESet
WinPOS 0. 25. 75. 9. 0. 0. W000
AREA.view

PRINT "resetting..."

RESet
SYStem.RESet
SYStem.CPU IMX6ULL

SYStem.Option DACR ON          ; give Debugger global write permissions
TrOnchip.Set DABORT OFF        ; used by Linux for page miss!
TrOnchip.Set PABORT OFF        ; used by Linux for page miss!
TrOnchip.Set UNDEF OFF         ; my be used by Linux for FPU detection
SYStem.Option MMUSPACES OFF    ; enable space ids to virtual addresses
SYStem.Option ResBreak OFF

SETUP.IMASKASM ON          ; lock interrupts while single stepping
SETUP.IMASKHLL ON          ; lock interrupts while single stepping in HLL

IF VERSION.BUILD()<92177.
(
  ; adjust WaitReset time if a different bootmode is used
  SYStem.Option WaitReset 10ms
)
ELSE
(
  ; poll till BootROM enables JTAG Pins
  SYStem.Option WaitIDCODE 1.5s
)
SYStem.JtagClock CTCK 20MHz
SYStem.Up

DO ~~/demo/arm/hardware/imx6ultralite/scripts/dcd_interpreter "imximage.cfg"

; Load u-boot in ddr
Data.LOAD.Binary &uboot_path/u-boot.bin 0x87800000 /NoClear
data.load.auto &uboot_path/u-boot /NoCODE
Register.Init
r.s pc 0x87800000

Mode.Hll
List

enddo
