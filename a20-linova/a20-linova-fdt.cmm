; --------------------------------------------------------------------------------
; @Title: A20-Linova Linux debugging Allwinner A20
; @Description:
;   The example is generated for A20-LiNova* boards using an ICD.
;   It will NOT run on any other board, but may be used as a template
;   for others.
; @Keywords: uboot, Allwinner, a20*, A20*
; @Author: Giulio Benetti <giulio.benetti@benettiengineering.com>
; @Board: A20-LiNova*
; @Chip: A20*
; @Copyright: (C) 2021 Benetti Engineering sas, licensed for use with TRACE32(R) only
; --------------------------------------------------------------------------------

LOCAL &uboot_path
LOCAL &linux_path
LOCAL &dtb_path
LOCAL &dtbo_path
LOCAL &ka_path
LOCAL &awareness

&uboot_path="/home/giuliobenetti/git/github/linova-u-boot"
&linux_path="/home/giuliobenetti/git/github/linova-linux"
&dtb_path="&linux_path/arch/arm/boot/dts"
&dtbo_path="/home/giuliobenetti/git/github/linova-overlays"

; Debugger Reset
WinPAGE.RESet
AREA.RESet
WinPOS 0. 25. 75. 9. 0. 0. W000
AREA.view

PRINT "resetting..."

RESet
SYStem.CPU A20
SYStem.CONFIG CoreNumber 1.
CORE.ASSIGN 1.

SYSTEM.RESETOUT ; hard reset
SYStem.JTAGCLOCK 20MHz

SYStem.Option DACR ON          ; give Debugger global write permissions
TrOnchip.Set DABORT OFF        ; used by Linux for page miss!
TrOnchip.Set PABORT OFF        ; used by Linux for page miss!
TrOnchip.Set UNDEF OFF         ; my be used by Linux for FPU detection
SYStem.Option MMUSPACES OFF    ; enable space ids to virtual addresses
SYStem.Option EnReset OFF

SYStem.Up

SETUP.IMASKASM ON          ; lock interrupts while single stepping
SETUP.IMASKHLL ON          ; lock interrupts while single stepping in HLL

; Load spl in sram
data.load.auto &uboot_path/spl/u-boot-spl
; Start and wait for spl to be executed and fail on sd-card boot
; (because there's no sd-card inserted)
Go
Wait 1s
Break

; Load DTB
PRINT "loading DTB..."
Data.LOAD.Binary &dtbo_path/sun7i-a20-linova1.dtb 0x43000000 /NoClear
PRINT "loading DTB Overlay..."
Data.LOAD.Binary &dtbo_path/aaa-overlay.dtbo 0x43c00000 /NoClear
PRINT "apply DTB Overlay..."

; Load real uboot
Data.LOAD.Binary &uboot_path/u-boot.bin 0x4a000000 /NoClear
; load u-boot symbols
data.load.elf &uboot_path/u-boot 0x14f6E000 /nocode /noreg
Register.Init
r.s pc 0x4a000000

;b.s fdt_overlay_apply_verbose

; Open serial terminal window on ttyUSB0
DO ~~/demo/etc/terminal/serial/term.cmm /dev/ttyUSB0 115200.

; Starting the kernel
Go
PRINT "Starting Linux..."
; Wait for uboot to be ready to receive characters on serial
wait 3s

break
b.s fdt_overlay_apply
Go

; Stop autoboot of U-Boot
TERM.Out 0x0a
WAIT 0.5s
; Set boot arguments
TERM.Out "setenv bootargs console=ttyS0,115200 ip=192.168.111.100:192.168.111.1 root=/dev/nfs rw nfsroot=192.168.111.1:/opt/a20_linova1_ctp_4_3i/nfs,vers=3 rootwait loglevel=8 drm_kms_helper.drm_fbdev_overalloc=200" 0xa
WAIT 0.5s
; apply fdt overlay
TERM.Out "fdt addr 0x43000000" 0x0a
TERM.Out "fdt resize 8192" 0x0a
TERM.Out "fdt apply 0x43c00000" 0x0a
WAIT 0.5s
; Boot Linux from memory: bootm <kernel>
;TERM.Out "bootz 0x42000000 - 0x43000000" 0x0a
;break

enddo
