; --------------------------------------------------------------------------------
; @Title: A20-LiNova U-Boot debugging Allwinner A20
; @Description:
;   The example is generated for A20-LiNova* boards using an ICD.
;   It will NOT run on any other board, but may be used as a template
;   for others.
; @Keywords: uboot, Allwinner, a20*, A20*
; @Author: Giulio Benetti <giulio.benetti@benettiengineering.com>
; @Board: A20-LiNova*
; @Chip: A20*
; @Copyright: (C) 2021 Benetti Engineering sas, licensed for use with TRACE32(R) only
; --------------------------------------------------------------------------------
; $Id: a20_linova_uboot.cmm

LOCAL &uboot_path

&uboot_path="/home/giuliobenetti/git/github/linova-u-boot"

; Debugger Reset
WinPAGE.RESet
AREA.RESet
WinPOS 0. 25. 75. 9. 0. 0. W000
AREA.view
 
PRINT "resetting..."

RESet
SYStem.CPU CortexA7MPCore
SYStem.CONFIG CoreNumber 1.
CORE.ASSIGN 1.

SYSTEM.RESETOUT ; hard reset
SYStem.JTAGCLOCK 20MHz

SYStem.CONFIG MEMORYACCESSPORT 0.
SYStem.CONFIG DEBUGACCESSPORT 1.
SYStem.CONFIG COREBASE              0x80110000
SYStem.CONFIG BMCBASE               0x80111000
SYStem.Option DACR ON          ; give Debugger global write permissions
TrOnchip.Set DABORT OFF        ; used by Linux for page miss!
TrOnchip.Set PABORT OFF        ; used by Linux for page miss!
TrOnchip.Set UNDEF OFF         ; my be used by Linux for FPU detection
SYStem.Option MMUSPACES OFF    ; enable space ids to virtual addresses
SYStem.Option EnReset OFF

; Allwinner A20 BROM
MAP.BONCHIP 0xffff0000--0xffff7fff

SETUP.IMASKASM ON          ; lock interrupts while single stepping
SETUP.IMASKHLL ON          ; lock interrupts while single stepping in HLL

SYStem.Up

;load spl in sram
data.load.auto &uboot_path/spl/u-boot-spl
; start and wait for spl to be executed and fail on sd-card boot
; (because there's no sd-card inserted)
go
wait 1s
break

data.load.binary &uboot_path/u-boot.bin 0x4a000000
data.load.auto &uboot_path/u-boot /nocode /noregister

r.s pc reset

go relocate_done
wait !run()

data.load.elf &uboot_path/u-boot Register(R4) /nocode
step

list.auto

enddo
