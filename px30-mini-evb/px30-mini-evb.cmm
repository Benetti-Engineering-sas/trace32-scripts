; --------------------------------------------------------------------------------
; @Title: PX30-Mini-evb debugging Rockchip PX30
; @Description:
;   The example is generated for Rockchip PX30
; @Keywords: Rockchip, px30*, PX30*
; @Author: Giulio Benetti <giulio.benetti@benettiengineering.com>
; @Board: PX30-MiniEVB*
; @Chip: PX30*
; @Copyright: (C) 2023 Benetti Engineering sas, licensed for use with TRACE32(R) only
; --------------------------------------------------------------------------------
; NOTE: in order to enable SWD pins SDMMC0_DET must be set high, so remove R9100

; Debugger Reset
WinPAGE.RESet
AREA.RESet
WinPOS 0. 25. 75. 9. 0. 0. W000
AREA.view

PRINT "resetting..."

RESet
SYStem.CPU CortexA35
SYStem.CONFIG CoreNumber 4.
CORE.ASSIGN 1.

; Rockchip PX30 Details
SYStem.CONFIG.DEBUGAP1.Port 0.

SYStem.CONFIG.COREDEBUG.Base 0x81010000 0x81012000 0x81014000 0x81016000
SYStem.CONFIG.BMC.Base 0x81011000 0x81013000 0x81015000 0x81017000
SYStem.CONFIG.CTI.Base 0x81018000 0x81019000 0x8101a000 0x8101b000

SYSTEM.RESETOUT ; hard reset
SYStem.CONFIG.DEBUGPORTTYPE SWD
IF COMBIPROBE()||UTRACE()
(
  SYStem.CONFIG.CONNECTOR MIPI20T
)

SYStem.MemAccess DAP
SYStem.JtagClock CTCK 20MHz

SYStem.Option EnReset OFF
SYStem.Option TRST OFF
SYStem.Option ResBreak OFF

SYStem.Option DACR ON          ; give Debugger global write permissions
SYStem.Option MMUSPACES OFF    ; disable space to allow loading and running u-boot

SETUP.IMASKASM ON          ; lock interrupts while single stepping
SETUP.IMASKHLL ON          ; lock interrupts while single stepping

SYStem.Up

enddo
